// SPDX-License-Identifier: BSD-3-Clause
/*
 * Copyright (c) 2025, Shandorman <98683030+jiganomegsdfdf@users.noreply.github.com>
 */

/dts-v1/;
#include "sm8550-oneplus-aston.dts"

&oplus_mem {
	reg = <0x00 0x80000000 0x00 0xe00000 0x00 0x811d0000 0x00 0x56e30000 0x00 0xd8140000 0x00 0x20000 0x00 0xd8800000 0x00 0x00 0x00 0xe1bb0000 0x00 0x1e450000 0x08 0x80000000 0x00 0x37900000 0x08 0xc0000000 0x00 0xc0000000 0x09 0x80000000 0x01 0x80000000>;
};